## arch/aarch64/boot/milkv_duo_s/boot.its
```
/dts-v1/;

/ {
    description = "HundeOS Milk-V Duo S ARM64";
    #address-cells = <2>;

    images {
        kernel-1 {
            description = "HundeOS AArch64 kernel handoff";
            data = /incbin/("handoff.bin");
            type = "kernel";
            arch = "arm64";
            os = "linux";
            compression = "none";
            load = <0x0 0x8d000000>;
            entry = <0x0 0x8d000000>;
        };

        kernel-payload {
            description = "HundeOS AArch64 kernel payload";
            data = /incbin/("kernel.img.lzma");
            type = "loadable";
            arch = "arm64";
            os = "linux";
            compression = "lzma";
            load = <0x0 0x84000000>;
        };

        fdt-sg2000_milkv_duos_glibc_arm64_sd {
            description = "Milk-V Duo S SG2000 ARM64";
            data = /incbin/("milkv_duo_s.dtb");
            type = "flat_dt";
            arch = "arm64";
            compression = "none";
            load = <0x0 0x8c000000>;
        };
    };

    configurations {
        default = "config-sg2000_milkv_duos_glibc_arm64_sd";

        config-sg2000_milkv_duos_glibc_arm64_sd {
            description = "HundeOS ARM64 on Milk-V Duo S";
            kernel = "kernel-1";
            loadables = "kernel-payload";
            fdt = "fdt-sg2000_milkv_duos_glibc_arm64_sd";
        };
    };
};
```

## arch/riscv64/boot/milkv_duo/bringup.its
```
/dts-v1/;

/ {
    description = "HundeOS Milk-V Duo bring-up";
    #address-cells = <2>;

    images {
        kernel {
            description = "HundeOS RISC-V bring-up payload";
            data = /incbin/("bringup.bin.lzma");
            type = "kernel";
            arch = "riscv";
            os = "linux";
            compression = "lzma";
            load = <0x0 0x80200000>;
            entry = <0x0 0x80200000>;
        };

        fdt {
            description = "Milk-V Duo CV1800B";
            data = /incbin/("milkv_duo.dtb");
            type = "flat_dt";
            arch = "riscv";
            compression = "none";
        };
    };

    configurations {
        default = "config-cv1800b_milkv_duo_sd";

        config-cv1800b_milkv_duo_sd {
            description = "HundeOS on Milk-V Duo";
            kernel = "kernel";
            fdt = "fdt";
        };
    };
};
```

## arch/riscv64/boot/milkv_duo_s/boot.its
```
/dts-v1/;

/ {
    description = "HundeOS Milk-V Duo S";
    #address-cells = <2>;

    images {
        kernel-handoff {
            description = "HundeOS RISC-V kernel handoff";
            data = /incbin/("handoff.bin");
            type = "kernel";
            arch = "riscv";
            os = "linux";
            compression = "none";
            load = <0x0 0x8d000000>;
            entry = <0x0 0x8d000000>;
        };

        kernel-payload {
            description = "HundeOS RISC-V kernel payload";
            data = /incbin/("kernel.img.lzma");
            type = "loadable";
            arch = "riscv";
            os = "linux";
            compression = "lzma";
            load = <0x0 0x84000000>;
        };

        fdt-cv1813h_milkv_duos_sd {
            description = "Milk-V Duo S SG2000";
            data = /incbin/("milkv_duo_s.dtb");
            type = "flat_dt";
            arch = "riscv";
            compression = "none";
            load = <0x0 0x8c000000>;
        };
    };

    configurations {
        default = "config-cv1813h_milkv_duos_sd";

        config-cv1813h_milkv_duos_sd {
            description = "HundeOS on Milk-V Duo S";
            kernel = "kernel-handoff";
            loadables = "kernel-payload";
            fdt = "fdt-cv1813h_milkv_duos_sd";
        };
    };
};
```
